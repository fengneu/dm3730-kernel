## linux-2.6.32-sbc8530/drivers/i2c/chips/Kconfig
```kconfig
#
# Miscellaneous I2C chip drivers configuration
#
# *** DEPRECATED! Do not add new entries! See Makefile ***
#

menu "Miscellaneous I2C Chip support"

config SENSORS_TSL2550
	tristate "Taos TSL2550 ambient light sensor"
	depends on EXPERIMENTAL
	help
	  If you say yes here you get support for the Taos TSL2550
	  ambient light sensor.

	  This driver can also be built as a module.  If so, the module
	  will be called tsl2550.

config SENSORS_TSL2x7x
	tristate "TAOS TSL/TMD2x71 and TSL/TMD2x72 Family of light and proximity sensors"
	depends on I2C
	help
	 Support for: tsl2571, tsl2671, tmd2671, tsl2771, tmd2771, tsl2572, tsl2672,
	 tmd2672, tsl2772, tmd2772 devices.
	 Provides direct access via sysfs.

config VGA_CH7026
        tristate "VGA CH7026 CHIP"
        depends on I2C
        help
         say yes to support VGA CH7026 CHIP.

config SENSORS_PCA963X
	tristate "Philips PCA963X 4-bit I2C-bus LED"
	depends on I2C && EXPERIMENTAL
	help
	 If you say yes here you get support for the Philips PCA963X
	 4-bit I2C-bus LED.

	 This driver can also be built as a module.  If so, the module
	 will be called pca963X.

endmenu
```

## linux-2.6.32-sbc8530/drivers/video/omap2/displays/Kconfig
```kconfig
menu "OMAP2/3 Display Device Drivers"
        depends on OMAP2_DSS

config PANEL_GENERIC
        tristate "Generic Panel"
        help
	  Generic panel driver.
	  Used for DVI output for Beagle and OMAP3 SDP.

config PANEL_LGPHILIPS_LB035Q02
	tristate "LG.Philips LB035Q02 LCD Panel"
	depends on OMAP2_DSS
	help
	  LCD Panel used on Overo Palo35

config PANEL_SAMSUNG_LTE430WQ_F0C
        tristate "Samsung LTE430WQ-F0C LCD Panel"
        depends on OMAP2_DSS
        help
          LCD Panel used on Overo Palo43

config PANEL_SHARP_LS037V7DW01
        tristate "Sharp LS037V7DW01 LCD Panel"
        depends on OMAP2_DSS
        help
          LCD Panel used in TI's SDP3430 and EVM boards

config PANEL_SHARP_LQ043T1DG01
        tristate "Sharp LQ043T1DG01 LCD Panel"
        depends on OMAP2_DSS
        help
          LCD Panel used in TI's OMAP3517 EVM boards

config PANEL_DEVKIT8500
        tristate "Devkit8500 LCD Panel"
        depends on OMAP2_DSS && MACH_OMAP3_DEVKIT8500
        help
          LCD Panel used in Timll Devkit8500 boards

config PANEL_DM3730_EVK
        tristate "DM3730_EVK LCD Panel"
        depends on OMAP2_DSS && MACH_DM3730_EVK
        help
          LCD Panel used in Timll DM3730_EVK boards

config PANEL_SBC8510
        tristate "SBC8510 LCD Panel"
        depends on OMAP2_DSS && MACH_OMAP3_SBC8510
        help
          LCD Panel used in Timll SBC8510 boards

config PANEL_SBC8100_PLUS
        tristate "SBC8100_PLUS LCD Panel"
        depends on OMAP2_DSS && MACH_OMAP3_SBC8100_PLUS
        help
          LCD Panel used in Timll SBC8100_PLUS boards

config PANEL_SBC8530
        tristate "SBC8530 LCD Panel"
        depends on OMAP2_DSS && MACH_OMAP3_SBC8530
        help
          LCD Panel used in Timll SBC8530 boards

choice
        prompt PANEL_TYPE
        depends on PANEL_DEVKIT8500 || PANEL_DM3730_EVK || PANEL_SBC8510 || PANEL_SBC8530 ||  PANEL_SBC8100_PLUS
        default LCD_43inch
	
config LCD_43inch
        bool "4.3 inch LCD support"

config LCD_7inch
        bool "7 inch LCD support"

config VGA
        bool "VGA support"
endchoice

config PANEL_TAAL
        tristate "Taal DSI Panel"
        depends on OMAP2_DSS_DSI
        help
          Taal DSI command mode panel from TPO.

endmenu
```

## linux-2.6.32-sbc8530/sound/soc/omap/Kconfig
```kconfig
config SND_OMAP_SOC
	tristate "SoC Audio for the Texas Instruments OMAP chips"
	depends on ARCH_OMAP

config SND_OMAP_SOC_MCBSP
	tristate
	select OMAP_MCBSP

config SND_OMAP_SOC_N810
	tristate "SoC Audio support for Nokia N810"
	depends on SND_OMAP_SOC && MACH_NOKIA_N810 && I2C
	select SND_OMAP_SOC_MCBSP
	select OMAP_MUX
	select SND_SOC_TLV320AIC3X
	help
	  Say Y if you want to add support for SoC audio on Nokia N810.

config SND_OMAP_SOC_AMS_DELTA
	tristate "SoC Audio support for Amstrad E3 (Delta) videophone"
	depends on SND_OMAP_SOC && MACH_AMS_DELTA
	select SND_OMAP_SOC_MCBSP
	select SND_SOC_CX20442
	help
	  Say Y  if you want to add support  for SoC audio device  connected to
	  a handset and a speakerphone found on Amstrad E3 (Delta) videophone.

	  Note that in order to get those devices fully supported,  you have to
	  build  the kernel  with  standard  serial port  driver  included  and
	  configured for at least 4 ports.  Then, from userspace, you must load
	  a line discipline #19 on the modem (ttyS3) serial line.  The simplest
	  way to achieve this is to install util-linux-ng  and use the included
	  ldattach  utility.  This  can be  started  automatically  from  udev,
	  a simple rule like this one should do the trick (it does for me):
	  	ACTION=="add", KERNEL=="controlC0", \
				RUN+="/usr/sbin/ldattach 19 /dev/ttyS3"

config SND_OMAP_SOC_OSK5912
	tristate "SoC Audio support for omap osk5912"
	depends on SND_OMAP_SOC && MACH_OMAP_OSK && I2C
	select SND_OMAP_SOC_MCBSP
	select SND_SOC_TLV320AIC23
	help
	  Say Y if you want to add support for SoC audio on osk5912.

config SND_OMAP_SOC_OVERO
	tristate "SoC Audio support for Gumstix Overo and CompuLab CM-T35"
	depends on TWL4030_CORE && SND_OMAP_SOC && (MACH_OVERO || MACH_CM_T35)
	select SND_OMAP_SOC_MCBSP
	select SND_SOC_TWL4030
	help
	  Say Y if you want to add support for SoC audio on the
	  Gumstix Overo or CompuLab CM-T35

config SND_OMAP_SOC_OMAP2EVM
	tristate "SoC Audio support for OMAP2EVM board"
	depends on TWL4030_CORE && SND_OMAP_SOC && MACH_OMAP2EVM
	select SND_OMAP_SOC_MCBSP
	select SND_SOC_TWL4030
	help
	  Say Y if you want to add support for SoC audio on the omap2evm board.

config SND_OMAP_SOC_OMAP3EVM
	tristate "SoC Audio support for OMAP3EVM board"
	depends on TWL4030_CORE && SND_OMAP_SOC && MACH_OMAP3EVM
	select SND_OMAP_SOC_MCBSP
	select SND_SOC_TWL4030
	help
	  Say Y if you want to add support for SoC audio on the omap3evm board.

config SND_OMAP_SOC_AM3517EVM
	tristate "SoC Audio support for OMAP3517 / AM3517 EVM"
	depends on SND_OMAP_SOC && MACH_OMAP3517EVM && I2C
	select SND_OMAP_SOC_MCBSP
	select SND_SOC_TLV320AIC23
	help
	  Say Y if you want to add support for SoC audio on the OMAP3517 / AM3517
	  EVM.

config SND_OMAP_SOC_SDP3430
	tristate "SoC Audio support for Texas Instruments SDP3430"
	depends on TWL4030_CORE && SND_OMAP_SOC && MACH_OMAP_3430SDP
	select SND_OMAP_SOC_MCBSP
	select SND_SOC_TWL4030
	help
	  Say Y if you want to add support for SoC audio on Texas Instruments
	  SDP3430.

config SND_OMAP_SOC_OMAP3_PANDORA
	tristate "SoC Audio support for OMAP3 Pandora"
	depends on TWL4030_CORE && SND_OMAP_SOC && MACH_OMAP3_PANDORA
	select SND_OMAP_SOC_MCBSP
	select SND_SOC_TWL4030
	help
	  Say Y if you want to add support for SoC audio on the OMAP3 Pandora.

config SND_OMAP_SOC_OMAP3_BEAGLE
	tristate "SoC Audio support for OMAP3 Beagle"
	depends on TWL4030_CORE && SND_OMAP_SOC && MACH_OMAP3_BEAGLE
	select SND_OMAP_SOC_MCBSP
	select SND_SOC_TWL4030
	help
	  Say Y if you want to add support for SoC audio on the Beagleboard.

config SND_OMAP_SOC_OMAP3_DEVKIT8500
        tristate "SoC Audio support for OMAP3 Devkit8500"
        depends on TWL4030_CORE && SND_OMAP_SOC && MACH_OMAP3_DEVKIT8500
        select SND_OMAP_SOC_MCBSP
        select SND_SOC_TWL4030
        help
          Say Y if you want to add support for SoC audio on the Devkit8500.

config SND_OMAP_SOC_DM3730_EVK
        tristate "SoC Audio support for DM3730_EVK"
        depends on TWL4030_CORE && SND_OMAP_SOC && MACH_DM3730_EVK
        select SND_OMAP_SOC_MCBSP
        select SND_SOC_TWL4030
        help
          Say Y if you want to add support for SoC audio on the DM3730_EVK.

config SND_OMAP_SOC_OMAP3_SBC8510
        tristate "SoC Audio support for OMAP3 SBC8510"
        depends on TWL4030_CORE && SND_OMAP_SOC && MACH_OMAP3_SBC8510
        select SND_OMAP_SOC_MCBSP
        select SND_SOC_TWL4030
        help
          Say Y if you want to add support for SoC audio on the SBC8510.

config SND_OMAP_SOC_OMAP3_SBC8100_PLUS
        tristate "SoC Audio support for OMAP3 SBC8100_PLUS"
        depends on TWL4030_CORE && SND_OMAP_SOC && MACH_OMAP3_SBC8100_PLUS
        select SND_OMAP_SOC_MCBSP
        select SND_SOC_TWL4030
        help
          Say Y if you want to add support for SoC audio on the SBC8100_PLUS.

config SND_OMAP_SOC_OMAP3_SBC8150
        tristate "SoC Audio support for OMAP3 SBC8150"
        depends on TWL4030_CORE && SND_OMAP_SOC && MACH_OMAP3_SBC8150
        select SND_OMAP_SOC_MCBSP
        select SND_SOC_TWL4030
        help
          Say Y if you want to add support for SoC audio on the SBC8150.

config SND_OMAP_SOC_OMAP3_SBC8530
        tristate "SoC Audio support for OMAP3 SBC8530"
        depends on TWL4030_CORE && SND_OMAP_SOC && MACH_OMAP3_SBC8530
        select SND_OMAP_SOC_MCBSP
        select SND_SOC_TWL4030
        help
          Say Y if you want to add support for SoC audio on the SBC8530.

config SND_OMAP_SOC_ZOOM2
	tristate "SoC Audio support for Zoom2"
	depends on TWL4030_CORE && SND_OMAP_SOC && MACH_OMAP_ZOOM2
	select SND_OMAP_SOC_MCBSP
	select SND_SOC_TWL4030
	help
	  Say Y if you want to add support for Soc audio on Zoom2 board.

config SND_OMAP_SOC_IGEP0020
	tristate "SoC Audio support for IGEP v2"
	depends on TWL4030_CORE && SND_OMAP_SOC && MACH_IGEP0020
	select SND_OMAP_SOC_MCBSP
	select SND_SOC_TWL4030
	help
	  Say Y if you want to add support for Soc audio on IGEP v2 board.
```
